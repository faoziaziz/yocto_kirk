## meta-coba/conf/layer.conf
```bitbake
# We have a conf and classes directory, add to BBPATH
BBPATH .= ":${LAYERDIR}"

# We have recipes-* directories, add to BBFILES
BBFILES += "${LAYERDIR}/recipes-*/*/*.bb \
            ${LAYERDIR}/recipes-*/*/*.bbappend"

BBFILE_COLLECTIONS += "meta-coba"
BBFILE_PATTERN_meta-coba = "^${LAYERDIR}/"
BBFILE_PRIORITY_meta-coba = "6"

LAYERDEPENDS_meta-coba = "core"
LAYERSERIES_COMPAT_meta-coba = "kirkstone"
```

## meta-tampan/conf/layer.conf
```bitbake
# We have a conf and classes directory, add to BBPATH
BBPATH .= ":${LAYERDIR}"

# We have recipes-* directories, add to BBFILES
BBFILES += "${LAYERDIR}/recipes-*/*/*.bb \
            ${LAYERDIR}/recipes-*/*/*.bbappend"

BBFILE_COLLECTIONS += "meta-tampan"
BBFILE_PATTERN_meta-tampan = "^${LAYERDIR}/"
BBFILE_PRIORITY_meta-tampan = "6"

IMAGE_INSTALL += " qtexample"
LAYERDEPENDS_meta-tampan = "core"
LAYERSERIES_COMPAT_meta-tampan = "kirkstone"
```
